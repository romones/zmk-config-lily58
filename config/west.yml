## config/west.yml
```yaml
manifest:
  remotes:
    - name: zmkfirmware
      url-base: https://github.com/zmkfirmware
    - name: narze
      url-base: https://github.com/narze
  projects:
    - name: zmk
      remote: narze
      revision: main
      import: app/west.yml
  self:
    path: config
```
